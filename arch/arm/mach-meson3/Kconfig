## arch/arm/mach-meson3/Kconfig
```kconfig
config AMLOGIC_OLD_REG_FUNC
	depends on ARCH_MESON3
	bool "Amlogic old reg operation compitable"
	default n
	help
		You should replace the register operation with 
		writel/readl/setbits_le32/clrbits_le32/clrsetbits_le32.
		the register name must be replace with P_REG_NAME . 
		REG_NAME is the old stlye reg name .
config AMLOGIC_PLAT_API_TEST
	depends on ARCH_MESON3
	bool "Plat api structure "
	default n
	help 
		This is the test purpose for new structure of Soc and BSP issues
		
	
```

## arch/arm/mach-meson3/Kconfig.boards
```kconfig
config MACH_M3_SKT
	depends on ARCH_MESON3=y
	bool "Support M3 (M3_SKT_V1) platform"
	select MESON_IRQ
	default y if ARCH_MESON3
	help
	  Include support for the AMLOGIC M3 Socket Emulation Baseboard platform.
```

## sound/soc/aml/m3/Kconfig
```kconfig
config SND_AML_M3
	tristate "M3 evaluation board with internal audio codec"
	depends on SND_AML_M3_SOC
	
config SND_AML_M3_PCM
	tristate "M3 evaluation board with PCM2BT"
	depends on SND_AML_M3
	select SND_SOC_PCM2BT if SND_AML_M3_PCM
	
config SND_AML_M3_CS4334
    tristate "AMLM3 board with CS4334"
    depends on SND_AML_M3_SOC
    select SND_SOC_CS4334 if SND_AML_M3_CS4334
```
